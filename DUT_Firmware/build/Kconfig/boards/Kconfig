## DUT_Firmware/build/Kconfig/boards/Kconfig
```kconfig
# Load Zephyr board Kconfig descriptions.
osource "/home/ayman/zephyrproject/zephyr/boards/weact/blackpill_f401cc/Kconfig"
```

## DUT_Firmware/build/Kconfig/boards/Kconfig.blackpill_f401cc.tmp
```kconfig
# Load board Kconfig descriptions.
osource "/home/ayman/zephyrproject/zephyr/boards/weact/blackpill_f401cc/Kconfig.blackpill_f401cc"
```

## DUT_Firmware/build/Kconfig/boards/Kconfig.defconfig
```kconfig
# Load Zephyr board defconfig descriptions.
osource "/home/ayman/zephyrproject/zephyr/boards/weact/blackpill_f401cc/Kconfig.defconfig"
```

## Zephyr_Firmware/build/Kconfig/arch/Kconfig
```kconfig
# Load Zephyr Arch Kconfig descriptions.
osource "/home/ayman/zephyrproject/zephyr/arch/rx/Kconfig"
osource "/home/ayman/zephyrproject/zephyr/arch/x86/Kconfig"
osource "/home/ayman/zephyrproject/zephyr/arch/xtensa/Kconfig"
osource "/home/ayman/zephyrproject/zephyr/arch/sparc/Kconfig"
osource "/home/ayman/zephyrproject/zephyr/arch/riscv/Kconfig"
osource "/home/ayman/zephyrproject/zephyr/arch/posix/Kconfig"
osource "/home/ayman/zephyrproject/zephyr/arch/mips/Kconfig"
osource "/home/ayman/zephyrproject/zephyr/arch/arm64/Kconfig"
osource "/home/ayman/zephyrproject/zephyr/arch/arm/Kconfig"
osource "/home/ayman/zephyrproject/zephyr/arch/arc/Kconfig"
```

## Zephyr_Firmware/build/Kconfig/boards/Kconfig.sysbuild.tmp
```kconfig
# Load Sysbuild board Kconfig descriptions.
osource "/home/ayman/zephyrproject/zephyr/boards/weact/blackpill_f401cc/Kconfig.sysbuild"
```

## basic_example/toggle_led/build/Kconfig/arch/Kconfig.tmp
```kconfig
# Load Zephyr Arch Kconfig descriptions.
osource "/home/mustafa/zephyrproject/zephyr/arch/rx/Kconfig"
osource "/home/mustafa/zephyrproject/zephyr/arch/x86/Kconfig"
osource "/home/mustafa/zephyrproject/zephyr/arch/xtensa/Kconfig"
osource "/home/mustafa/zephyrproject/zephyr/arch/sparc/Kconfig"
osource "/home/mustafa/zephyrproject/zephyr/arch/riscv/Kconfig"
osource "/home/mustafa/zephyrproject/zephyr/arch/posix/Kconfig"
osource "/home/mustafa/zephyrproject/zephyr/arch/mips/Kconfig"
osource "/home/mustafa/zephyrproject/zephyr/arch/arm64/Kconfig"
osource "/home/mustafa/zephyrproject/zephyr/arch/arm/Kconfig"
osource "/home/mustafa/zephyrproject/zephyr/arch/arc/Kconfig"
```

## basic_example/toggle_led/build/Kconfig/boards/Kconfig.blackpill_f401cc.tmp
```kconfig
# Load board Kconfig descriptions.
osource "/home/mustafa/zephyrproject/zephyr/boards/weact/blackpill_f401cc/Kconfig.blackpill_f401cc"
```

## basic_example/toggle_led/build/Kconfig/boards/Kconfig.defconfig.tmp
```kconfig
# Load Zephyr board defconfig descriptions.
osource "/home/mustafa/zephyrproject/zephyr/boards/weact/blackpill_f401cc/Kconfig.defconfig"
```

## basic_example/toggle_led/build/Kconfig/boards/Kconfig.sysbuild.tmp
```kconfig
# Load Sysbuild board Kconfig descriptions.
osource "/home/mustafa/zephyrproject/zephyr/boards/weact/blackpill_f401cc/Kconfig.sysbuild"
```

## basic_example/toggle_led/build/Kconfig/boards/Kconfig.tmp
```kconfig
# Load Zephyr board Kconfig descriptions.
osource "/home/mustafa/zephyrproject/zephyr/boards/weact/blackpill_f401cc/Kconfig"
```
