#include <zephyr/kernel.h>              /* Include Zephyr kernel APIs */
#include <zephyr/device.h>              /* Include Zephyr device model APIs */
#include <zephyr/drivers/spi.h>         /* Include Zephyr SPI driver APIs */
#include <zephyr/sys/printk.h>          /* Include printk for debug messages */
#include <errno.h>                      /* Include standard error codes */

#include "dut_spi.h"                    /* Include DUT SPI module interface */


/* Get SPI1 node from devicetree */
#define SPI_NODE DT_NODELABEL(spi1)

/* Define the response byte that DUT sends to the master */
#define DUT_SPI_RESPONSE_BYTE 0x5A

/* Define SPI slave thread stack size */
#define DUT_SPI_THREAD_STACK_SIZE 1024

/* Define SPI slave thread priority */
#define DUT_SPI_THREAD_PRIORITY 7


/* Get SPI1 device from devicetree */
static const struct device *spi_dev = DEVICE_DT_GET(SPI_NODE);

/* Store SPI initialization state */
static bool spi_initialized = false;


/* Configure SPI1 as slave */
static struct spi_config spi_cfg = {
    .frequency = 1000000U,                              /* SPI clock is generated by master */
    .operation = SPI_OP_MODE_SLAVE |                    /* Configure SPI as slave */
                 SPI_TRANSFER_MSB |                     /* Transfer most significant bit first */
                 SPI_WORD_SET(8) |                      /* Use 8-bit word size */
                 SPI_LINES_SINGLE,                      /* Use standard MOSI/MISO lines */
    .slave = 0                                          /* Slave index */
};


/**
 * @brief SPI slave responder thread.
 *
 * This thread waits for SPI transfers from the master.
 * For every transfer, it sends 0x5A and receives one byte.
 */
static void dut_spi_thread(void *arg1, void *arg2, void *arg3)
{
    ARG_UNUSED(arg1);                                    /* Mark arg1 as unused */
    ARG_UNUSED(arg2);                                    /* Mark arg2 as unused */
    ARG_UNUSED(arg3);                                    /* Mark arg3 as unused */

    while (!spi_initialized) {                           /* Wait until SPI initialization is done */
        k_sleep(K_MSEC(10));                             /* Sleep before checking again */
    }

    printk("DUT SPI slave thread started\n");            /* Print SPI thread start message */

    while (1) {                                          /* Run forever */
        uint8_t tx_data = DUT_SPI_RESPONSE_BYTE;         /* Prepare fixed response byte */
        uint8_t rx_data = 0x00;                          /* Store received byte from master */

        const struct spi_buf tx_buf = {                  /* Create TX buffer */
            .buf = &tx_data,                             /* Point to response byte */
            .len = sizeof(tx_data)                       /* Send one byte */
        };

        struct spi_buf rx_buf = {                        /* Create RX buffer */
            .buf = &rx_data,                             /* Store received byte here */
            .len = sizeof(rx_data)                       /* Receive one byte */
        };

        const struct spi_buf_set tx_set = {              /* Create TX buffer set */
            .buffers = &tx_buf,                          /* Point to TX buffer */
            .count = 1                                   /* Use one TX buffer */
        };

        const struct spi_buf_set rx_set = {              /* Create RX buffer set */
            .buffers = &rx_buf,                          /* Point to RX buffer */
            .count = 1                                   /* Use one RX buffer */
        };

        int ret = spi_transceive(spi_dev, &spi_cfg, &tx_set, &rx_set); /* Wait for master transfer */

        if (ret == -ETIMEDOUT) {                         /* No SPI transfer received yet */
            k_yield();                                   /* Give CPU time to other threads */
            continue;                                    /* Re-arm SPI slave quickly */
        }

        if (ret < 0) {                                   /* Check if real SPI transfer error happened */
            printk("DUT SPI transfer error: %d\n", ret); /* Print SPI error */
            k_sleep(K_MSEC(10));                         /* Small delay before retrying */
            continue;                                    /* Retry next cycle */
        }

        printk("DUT SPI RX 0x%02X TX 0x%02X\n", rx_data, tx_data); /* Print transfer result */
    }
}


/* Define and start SPI slave responder thread */
K_THREAD_DEFINE(
    dut_spi_thread_id,                                   /* Thread ID */
    DUT_SPI_THREAD_STACK_SIZE,                           /* Stack size */
    dut_spi_thread,                                      /* Thread entry function */
    NULL,                                                /* First argument */
    NULL,                                                /* Second argument */
    NULL,                                                /* Third argument */
    DUT_SPI_THREAD_PRIORITY,                             /* Thread priority */
    0,                                                   /* Thread options */
    0                                                    /* Start immediately */
);


/**
 * @brief Initialize DUT SPI slave responder.
 *
 * @return 0 on success, negative error code on failure.
 */
int dut_spi_Init(void)
{
    if (!device_is_ready(spi_dev)) {                     /* Check if SPI1 device is ready */
        return -ENODEV;                                  /* Return error if SPI1 is not ready */
    }

    spi_initialized = true;                              /* Allow SPI thread to start responding */

    return 0;                                            /* Return success */
}